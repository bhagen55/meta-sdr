## meta-sdr/conf/layer.conf
```bitbake
# We have a conf and classes directory, append to BBPATH
BBPATH .= ":${LAYERDIR}"

# We have a recipes directory containing .bb and .bbappend files, add to BBFILES
BBFILES += "${LAYERDIR}/recipes*/*/*.bb \
            ${LAYERDIR}/recipes*/*/*.bbappend"

BBFILE_COLLECTIONS += "sdr-layer"
BBFILE_PATTERN_sdr-layer := "^${LAYERDIR}/"
LAYERSERIES_COMPAT_sdr-layer = "kirkstone"
BBFILE_PRIORITY_sdr-layer = "10"
```
